## config/boards/shields/briquet/Kconfig.defconfig
```kconfig
config ZMK_BLE
    default y

config ZMK_USB
    default y

if SHIELD_BRIQUET_LEFT

config ZMK_KEYBOARD_NAME
	default "Briquet"

config ZMK_SPLIT_ROLE_CENTRAL
    default y

endif

if SHIELD_BRIQUET_LEFT || SHIELD_BRIQUET_RIGHT

config ZMK_SPLIT
    default y

endif
```

## config/boards/shields/briquet/Kconfig.shield
```kconfig
config SHIELD_BRIQUET_LEFT
	def_bool $(shields_list_contains,briquet_left)

config SHIELD_BRIQUET_RIGHT
	def_bool $(shields_list_contains,briquet_right)
```

## config/west.yml
```yaml
manifest:
  remotes:
    - name: yesitsfebreeze
      url-base: https://github.com/yesitsfebreeze
  projects:
    - name: zmk
      remote: yesitsfebreeze
      revision: main
      import: app/west.yml
  self:
    path: config
```
